## base_external/Config.in
```kconfig
#source "$BR2_EXTERNAL_project_base_PATH/package/lcd_package/Config.in"
source "$BR2_EXTERNAL_project_base_PATH/package/server_rfid_package/Config.in"
source "$BR2_EXTERNAL_project_base_PATH/package/client_lcd_package/Config.in"
```

## base_external/package/client_lcd_package/Config.in
```kconfig
config BR2_PACKAGE_CLIENT_LCD_PACKAGE
	bool "client_lcd_package"
	help
	  Includes the client side lcd executable, wiringpi library in the kernel image.
	  Used to understand buildroot external trees and package builds.
```

## base_external/package/server_rfid_package/Config.in
```kconfig
config BR2_PACKAGE_SERVER_RFID_PACKAGE
	bool "server_rfid_package"
	help
	  Includes the server side rfid executable, wiringpi library in the kernel image.
	  Used to understand buildroot external trees and package builds.
```
